## arch/arm/mach-msm/cust_sky/Kconfig
```kconfig
if CUST_SKY_H

#
# CUST SKY FEATURE SECTION
#
menu "CUST SKY FEATURE SECTION"

config PANTECH
	bool "PANTECH Common Configuration"
	default y
	help
		Support PANTECH


if MACH_MSM8X60_EF65L
config DEFINE_LIST_EF65L
	bool
	default y
	select SKY_EF65L_BOARD
	select PANTECH_CAMERA
	select SKY_GSBI12_UART_CONSOLE
	select SKY_WLAN_MMC
	select SKY_SND_EXTAMP
	select SKY_SND_CTRL
	select SKY_SND_VT_VOIP
	select SKY_SND_MVS
	select SKY_MMC
	select F_SKYDISP_BOOT_LOGO_IN_KERNEL
	select F_SKYDISP_FRAMEBUFFER_32
	select F_SKYDISP_QBUG_FIX_BACKLIGHT
	select F_SKYDISP_LCD_FORCE_ONOFF
	select F_SKYDISP_LCD_RESET
	select F_SKYDISP_FIX_ONE_LINE_YRES
	select F_SKYDISP_QBUG_FIX_MIPI_ERROR
	select F_SKYDISP_HDMI_CAPTION
	select F_SKYDISP_HDMI_OPTION
	select F_SKYDISP_HDMI_AUDIO_BUGFIX 		
	select F_SKYDISP_MHL_REMOTE_CTRL
	select PANTECH_BT
	select PANTECH_PWR_ONOFF_REASON_CNT
	select PANTECH_ERR_CRASH_LOGGING
	select SW_RESET
	select PANTECH_EXT4_RO_REMOUNT_ON_EMERGENCY_RESET
	select PANTECH_WDOG_WORKAROUND
	select USB_ANDROID_ACCESSORY
#	select EF65L_MDM_RAMDMUP_ENABLE
#	select PANTECH_APPSBARK_FIQ
endif


comment "PANTECH_ERR_CRASH_LOGGING Configuration"
config PANTECH_ERR_CRASH_LOGGING
	bool

comment "EF65L_MDM_RAMDUMP_ENABLE" 
config EF65L_MDM_RAMDMUP_ENABLE
	bool

comment "SKY_EF65L_BOARD Configuration"
config SKY_EF65L_BOARD
	bool

config PANTECH_CAMERA
	bool

comment "SKY_GSBI12_UART_CONSOLE Configuration"
config SKY_GSBI12_UART_CONSOLE
	bool

comment "SKY WLAN"
config SKY_WLAN
	bool "EF65 WLAN"
	default y
	help
		Support EF65 WLAN

config PANMAC
	bool "WLAN MAC ADDRESS"
	default y
	help
		Support PANMAC

config SKY_WLAN_MMC
	bool	
	
config PANTECH_WIFI_MMC
	bool
config SKY_SND_EXTAMP
    bool 
        
config SKY_SND_CTRL
    bool 

config SKY_SND_VT_VOIP
    bool 
        
config SKY_SND_MVS
    bool 

config SKY_MMC
    bool 

config PANTECH_BT
	bool

config F_SKYDISP_BOOT_LOGO_IN_KERNEL
	bool 

config F_SKYDISP_QBUG_FIX_BACKLIGHT
	bool 

config F_SKYDISP_LCD_RESET
	bool 

config F_SKYDISP_LCD_FORCE_ONOFF
	bool 

config F_SKYDISP_FRAMEBUFFER_32
	bool 

config F_SKYDISP_FIX_ONE_LINE_YRES
	bool

config F_SKYDISP_QBUG_FIX_MIPI_ERROR
	bool

config F_SKYDISP_HDMI_CAPTION
	bool 

config F_SKYDISP_HDMI_OPTION
	bool 

config F_SKYDISP_HDMI_AUDIO_BUGFIX 
	bool	

config F_SKYDISP_MHL_REMOTE_CTRL
	bool 
	
# Added by Sungwook@LS4.2011-09-28
# CONFIG_PANTECH_PWR_ONOFF_REASON_CNT
comment "PANTECH_PWR_ONOFF_REASON_CNT Configuration"
config PANTECH_PWR_ONOFF_REASON_CNT
        bool
# Added by Sungwook@LS4.2011-09-28
# CONFIG_SW_RESET
comment "SW_RESET Configuration"
config SW_RESET
	depends on PANTECH_ERR_CRASH_LOGGING
	depends on PANTECH_PWR_ONOFF_REASON_CNT
	bool
config PANTECH_WDOG_WORKAROUND
	depends on SW_RESET
	bool

# Added by Sungwook@LS4.2011-09-29
# CONFIG_PANTECH_EXT4_RO_REMOUNT_ON_EMERGENCY_RESET
#
# Added by Sungwook@LS4.2011-09-29
# Add options to the reboot syscall to remount filesystems ro
# Auther: Ken Sumrall
# Date: March 03rd, 2011
# Reference from
# http://us.generation-nt.com/answer/patch-syscalls-reboot-add-
# options-reboot-syscall-remount-filesystems-ro-help-202386552.html
#
comment "SW_RESET Configuration"
config PANTECH_EXT4_RO_REMOUNT_ON_EMERGENCY_RESET
        bool
	help
		Add 4 new commands to the reboot system call, that do the same thing as the
		RESTART, HALT, POWER_OFF, and RESTART2 commands, but also remount writable
		filesystems as read-only just before doing what the command normally does.
		Now that Android is using EXT4, and since we don't have a standard init
		setup to unmount filesystems before rebooting, this allows the system to
		reboot with clean filesystems, and also improves boot time as the journal
		does not need to be replayed when mounting the filesystem.	

config USB_ANDROID_ACCESSORY
	depends on USB_ANDROID_PANTECH
	bool "PANTECH ACCESSORY FUNCTION"
	default y
	help
		Support Pantech ACCESSORY function Driver

#config PANTECH_APPSBARK_FIQ
#	bool
	
endmenu

endif
```

## drivers/input/sensor/Kconfig
```kconfig
#
# Sensor driver configuration
#
menuconfig INPUT_SENSOR
	bool "Sensors"
	default y
	help
	  Say Y here, and a list of supported sensorss will be displayed.
	  This option doesn't affect the kernel.

	  If unsure, say Y.

if INPUT_SENSOR

#### EF65L ####
if MACH_MSM8X60_EF65L
config EF65L_SENSORS_APDS9900_SW
	tristate "Avago apds9900 proximity and light sensor"
	depends on I2C
	default y
	help
	  Say Y here if you have a APDS9900 sensor and want to enable
	  support for the built-in sensor.

config EF65L_SENSORS_MPU3050
	tristate "InvenSense mpu3050 gyro sensor"
	depends on I2C
	default y
	help
	  Say Y here if you have a MPU3050 sensor and want to enable
	  support for the built-in sensor.

config EF65L_SENSORS_MPU_DEBUG
	tristate "InvenSense mpu debug enable"
	depends on EF65L_SENSORS_MPU3050
	default n
	help
	  Say Y here if you have a yas529 sensor and want to enable
	  support for the built-in sensor.

config EF65L_SENSORS_BMA150
	tristate "Bocsh bma150 accelerometer sensor"
	depends on EF65L_SENSORS_MPU3050
	default n
	help
	  Say Y here if you have a bma150 sensor and want to enable
	  support for the built-in sensor.

config EF65L_SENSORS_BMA250
	tristate "Bocsh bma250 accelerometer sensor"
	depends on EF65L_SENSORS_MPU3050
	default y
	help
	  Say Y here if you have a bma250 sensor and want to enable
	  support for the built-in sensor.

config EF65L_SENSORS_YAS530
	tristate "Yamaha yas529 magnetic field sensor"
	depends on EF65L_SENSORS_MPU3050
	default y
	help
	  Say Y here if you have a yas530 sensor and want to enable
	  support for the built-in sensor.
endif

endif
```
